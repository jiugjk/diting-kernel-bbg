## panda-hide-in-tree/Kconfig
```kconfig
# SPDX-License-Identifier: GPL-2.0
menu "Panda Hide (frida/debugger hiding)"

config PANDA_HIDE
	bool "Enable panda-hide (in-tree port of kpm-panda-hide)"
	depends on SECURITY
	depends on NET
	default y
	help
	  In-tree port of https://github.com/P4nda0s/kpm-panda-hide

	  Preferred backend is zero-kprobe static call-site patches
	  (fs/proc/array.c, task_mmu.c, exec.c, open.c, memory.c) plus
	  a small policy library and LSM socket_connect hook.

	  Optional kprobe backend remains available for trees where
	  static patches cannot be applied.

config PANDA_HIDE_STATIC
	bool "Use zero-kprobe static source patches"
	depends on PANDA_HIDE
	default y
	help
	  Expects scripts/apply-panda-static.py to have patched:
	    fs/proc/array.c
	    fs/proc/base.c
	    fs/proc/task_mmu.c
	    fs/exec.c
	    fs/open.c
	    mm/memory.c
	  Say Y.

config PANDA_HIDE_KPROBES
	bool "Also build runtime kprobe backend"
	depends on PANDA_HIDE
	depends on KPROBES
	depends on KALLSYMS
	default n
	help
	  Legacy/runtime hooks via kprobe/kretprobe. Not needed when
	  PANDA_HIDE_STATIC patches are applied. Can double-hide if both on.

endmenu
```
